// SPDX-License-Identifier: (GPL-2.0+ OR MIT)
/*
 * Copyright (c) 2021 Rockchip Electronics Co., Ltd.
 *
 */

/dts-v1/;

#include "roc-rk3588s-pc-v12.dtsi"

/ {
	model = "Firefly ROC-RK3588S-PC V12 HDMI(Linux)";
	compatible = "rockchip,roc-rk3588s-pc", "rockchip,rk3588";
};
