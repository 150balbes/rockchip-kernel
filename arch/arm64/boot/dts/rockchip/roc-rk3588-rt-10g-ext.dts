// SPDX-License-Identifier: (GPL-2.0+ OR MIT)
/*
 * Copyright (c) 2021 Rockchip Electronics Co., Ltd.
 *
 */

/dts-v1/;

#include "roc-rk3588-rt-10g-ext.dtsi"

/ {
	model = "Firefly ROC-RK3588-RT-10G-EXT HDMI(Linux)";
	compatible = "rockchip,roc-rk3588-rt-10g-ext", "rockchip,rk3588";
};

