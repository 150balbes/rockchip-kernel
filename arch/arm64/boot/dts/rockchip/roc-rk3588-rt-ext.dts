// SPDX-License-Identifier: (GPL-2.0+ OR MIT)
/*
 * Copyright (c) 2021 Rockchip Electronics Co., Ltd.
 *
 */

/dts-v1/;

#include "roc-rk3588-rt-ext.dtsi"

/ {
	model = "Firefly ROC-RK3588-RT-EXT HDMI(Linux)";
	compatible = "rockchip,roc-rk3588-rt-ext", "rockchip,rk3588";
};

