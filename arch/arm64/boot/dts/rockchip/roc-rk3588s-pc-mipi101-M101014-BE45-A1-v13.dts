// SPDX-License-Identifier: (GPL-2.0+ OR MIT)
/*
 * Copyright (c) 2021 Rockchip Electronics Co., Ltd.
 *
 */

/dts-v1/;

#include "roc-rk3588s-pc-mipi101-M101014-BE45-A1-v13.dtsi"

/ {
	model = "Firefly ROC-RK3588S-PC V13 MIPI(Linux)";
	compatible = "rockchip,roc-rk3588s-pc", "rockchip,rk3588";

};
