// SPDX-License-Identifier: (GPL-2.0+ OR MIT)
/*
 * Copyright (c) 2021 Rockchip Electronics Co., Ltd.
 *
 */

/dts-v1/;

#include "rk3588s-orangepi-5.dts"

/ {
	model = "Orange Pi 5 USB-C";
	compatible = "rockchip,roc-rk3588s-pc", "rockchip,rk3588s", "rockchip,rk3588";
};

&usbdrd_dwc3_0 {
    status = "okay";
    dr_mode = "otg";
    usb-role-switch;
    port {
	#address-cells = <1>;
	#size-cells = <0>;
	dwc3_0_role_switch: endpoint@0 {
	    reg = <0>;
	    remote-endpoint = <&usbc0_role_sw>;
	};
    };
};
