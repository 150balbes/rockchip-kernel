## drivers/net/ethernet/mucse/Kconfig
```kconfig
# SPDX-License-Identifier: GPL-2.0-only
#
# Mucse network device configuration
#

config NET_VENDOR_MUCSE
        bool "Mucse devices"
        default y
        help
          If you have a network (Ethernet) card belonging to this class, say Y.

          Note that the answer to this question doesn't directly affect the
          kernel: saying N will just cause the configurator to skip all
          the questions about Mucse cards. If you say Y, you will be asked for
          your specific card in the following questions.


if NET_VENDOR_MUCSE

config MXGBE
	tristate "Mucse(R) 1/10/25/40GbE PCI Express adapters support"
        depends on PCI
        imply PTP_1588_CLOCK
        help
          This driver supports Mucse(R) 1/10/25/40GbE PCI Express family of
          adapters.

          To compile this driver as a module, choose M here. The module
          will be called rnp.

config MXGBE_FIX_VF_BUG
        bool "Fix VF Bug Support(pf)"
        default y
        depends on MXGBE
        help
          Say Y here if you want to fix vf bug in the driver.

          If unsure, say N.

config MXGBE_FIX_MAC_PADDIN
	bool "Close Mac Padding Function(pf)"
	default y
        depends on MXGBE
        help
          Say Y here if you want to fix close mac padding in the driver.

          If unsure, say N.

config MXGBE_MSIX_COUNT
	int "Number of msix count"
	default "64"
	depends on MXGBE
        help
          MXGBE range [2,64].


config MXGBEVF
	tristate "Mucse(R) 1/10/25/40G PCI Express Virtual Function adapters support"
        depends on PCI
        help
          This driver supports Mucse(R) 1/10/25/40GbE PCI Express family of
          adapters.

          To compile this driver as a module, choose M here. The module
          will be called rnpvf.

config MXGBEVF_FIX_VF_BUG
        bool "Fix VF Bug Support(vf)"
        default y
        depends on MXGBEVF
        help
          Say Y here if you want to fix vf bug in the driver.

          If unsure, say N.

config MXGBEVF_FIX_MAC_PADDIN
	bool "Close Mac Padding Function(vf)"
	default y
        depends on MXGBEVF
        help
          Say Y here if you want to fix close mac padding in the driver.

          If unsure, say N.

#config MXGBEM
#	tristate "Mucse(R) 1/10GbE PCI Express 2/4 ports adapters support"
#        depends on PCI
#        imply PTP_1588_CLOCK
#        help
#          This driver supports Mucse(R) 1/10GbE 2/4 ports PCI Express family of
#          adapters.
#
#          To compile this driver as a module, choose M here. The module
#          will be called rnpm.

endif # NET_VENDOR_MUCSE
```

## drivers/net/wireless/rockchip_wlan/rtl8821cu/Kconfig
```kconfig
config RTL8821CU_RK
	tristate "Realtek 8821C USB WiFi RK"
	depends on USB
	help
	  Help message of RTL8821CU
```

## drivers/video/lt9211c/Kconfig
```kconfig
menuconfig GPIOLIB
	bool "GPIO Support"
	help
	  This enables GPIO support through the generic GPIO library.
	  You only need to enable this, if you also want to enable
	  one or more of the GPIO drivers below.

	  If unsure, say N.

config LT9211C_DRIVER
	tristate "Loutium LT9211C"
	default y
	help
	nothing
```
